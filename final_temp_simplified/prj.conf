## CMakeLists.txt
```
# SPDX-License-Identifier: Apache-2.0

cmake_minimum_required(VERSION 3.20.0)

find_package(Zephyr REQUIRED HINTS $ENV{ZEPHYR_BASE})
project(hello_world_4)

target_sources(app PRIVATE src/main.c)

# Custom files and folders

target_sources(app PRIVATE
    src/remote_service/remote.c
)

zephyr_library_include_directories(src/remote_service)
```

## prj.conf
```kconfig
CONFIG_MAIN_STACK_SIZE=2048
CONFIG_HEAP_MEM_POOL_SIZE=1024


CONFIG_PM=y
CONFIG_PM_DEVICE=y
CONFIG_PM_DEVICE_RUNTIME=y

CONFIG_BT=y
CONFIG_BT_PERIPHERAL=y
CONFIG_BT_DEVICE_NAME="Remote_controller"
CONFIG_BT_MAX_CONN=1
CONFIG_BT_LL_SOFTDEVICE=y


CONFIG_CONSOLE=n
CONFIG_PRINTK=n
CONFIG_LOG=n
CONFIG_LOG_BACKEND_UART=n
CONFIG_USE_SEGGER_RTT=n
CONFIG_LOG_BACKEND_RTT=n
CONFIG_UART_CONSOLE=n
CONFIG_STDOUT_CONSOLE=n
CONFIG_SERIAL=n
```

## src/main.c
```c
// main.c — BLE temp peripheral (no UART/RTT/logging)

#include <zephyr/kernel.h>
#include <zephyr/bluetooth/bluetooth.h>
#include <zephyr/bluetooth/conn.h>

#include "remote.h"

static struct bt_conn *current_conn = NULL;
static uint32_t sample_count = 0;

static void on_connected(struct bt_conn *conn, uint8_t err)
{
    if (!err) {
        current_conn = bt_conn_ref(conn);
        const struct bt_le_conn_param param = {
            .interval_min = 80,   
            .interval_max = 400, 
            .latency      = 4,
            .timeout      = 600 
        };
        bt_conn_le_param_update(conn, &param);
    }
}

static void on_disconnected(struct bt_conn *conn, uint8_t reason)
{
    ARG_UNUSED(reason);
    if (current_conn) {
        bt_conn_unref(current_conn);
        current_conn = NULL;
    }
}


static void on_data_received(struct bt_conn *conn, const uint8_t *const data, uint16_t len)
{
    ARG_UNUSED(conn);
    ARG_UNUSED(data);
    ARG_UNUSED(len);
}


static struct bt_conn_cb bluetooth_callbacks = {
    .connected    = on_connected,
    .disconnected = on_disconnected,
};

static struct bt_remote_service_cb remote_callbacks = {
    .data_received = on_data_received,
};

void main(void)
{
    int err = bluetooth_init(&bluetooth_callbacks, &remote_callbacks);
    ARG_UNUSED(err);

    while (1) {
        k_sleep(K_SECONDS(1));
        sample_count++;
        while (!current_conn) {
            k_sleep(K_SECONDS(1));
        }

        if (current_conn) {
            uint32_t temp_val = call_read_temp();   
            if ((sample_count % 1) == 0) {
                send_temp_notification(current_conn, temp_val);
            }
        }
    }
}
```

## src/ble_disconnect_main.c
```c
#include <zephyr/kernel.h>
#include <zephyr/bluetooth/bluetooth.h>
#include <zephyr/bluetooth/conn.h>

#include "remote.h"

static struct bt_conn *current_conn = NULL;
static bool notify_enabled = false;

static void on_connected(struct bt_conn *conn, uint8_t err)
{
    if (!err) {
        current_conn = bt_conn_ref(conn);
        notify_enabled = true;
    }
}

static void on_disconnected(struct bt_conn *conn, uint8_t reason)
{
    if (current_conn) {
        bt_conn_unref(current_conn);
        current_conn = NULL;
    }
    notify_enabled = false;
    bt_le_adv_stop();
}

static void on_ccc_changed(const struct bt_gatt_attr *attr, uint16_t value)
{
    notify_enabled = (value == BT_GATT_CCC_NOTIFY);
}

static struct bt_conn_cb bt_callbacks = {
    .connected = on_connected,
    .disconnected = on_disconnected,
};

static struct bt_remote_service_cb remote_callbacks = {
    .data_received = NULL,
};

static void start_advertising(void)
{
    const struct bt_data ad[] = {
        BT_DATA_BYTES(BT_DATA_FLAGS, (BT_LE_AD_GENERAL | BT_LE_AD_NO_BREDR)),
        BT_DATA(BT_DATA_NAME_COMPLETE, CONFIG_BT_DEVICE_NAME, sizeof(CONFIG_BT_DEVICE_NAME) - 1)
    };

    const struct bt_data sd[] = {
        BT_DATA_BYTES(BT_DATA_UUID128_ALL, BT_UUID_REMOTE_SERV_VAL),
    };

    bt_le_adv_start(BT_LE_ADV_CONN, ad, ARRAY_SIZE(ad), sd, ARRAY_SIZE(sd));
}

void main(void)
{
    bluetooth_init(&bt_callbacks, &remote_callbacks);
    start_advertising();

    while (1) {
        while (!current_conn || !notify_enabled) {
            k_sleep(K_MSEC(200));
        }

        k_sleep(K_SECONDS(1)); 

        uint32_t temp_val = call_read_temp();
        send_temp_notification(current_conn, temp_val);
        
        bt_conn_disconnect(current_conn, BT_HCI_ERR_REMOTE_USER_TERM_CONN);

        k_sleep(K_SECONDS(10));

        start_advertising();
    }
}
```
